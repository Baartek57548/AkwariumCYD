## firmware/esp32c6_gateway/main/Kconfig.projbuild
```kconfig
menu "AquaCYD ESP32-C6 gateway"

config AQUACYD_WIFI_SSID
    string "2.4 GHz Wi-Fi SSID"
    default ""

config AQUACYD_WIFI_PASSWORD
    string "Wi-Fi password"
    default ""

config AQUACYD_MQTT_BROKER_URI
    string "MQTT broker URI"
    default "mqtts://aquahub.local:8883"

config AQUACYD_MQTT_EMBED_HUB_CERTIFICATE
    bool "Embed the verified AquaHub TLS certificate"
    default n
    help
        Requires main/aquahub.pem generated with tools/pin-aquahub-certificate.ps1.
        The gateway refuses mqtts:// connections when this option is disabled.

config AQUACYD_MQTT_USERNAME
    string "MQTT username"
    default ""

config AQUACYD_MQTT_PASSWORD
    string "MQTT password"
    default ""

config AQUACYD_MQTT_BASE_TOPIC
    string "MQTT base topic"
    default "aquacyd/aquarium"

config AQUACYD_DEVICE_ID
    string "Home Assistant device identifier"
    default "aquacyd_aquarium"

config AQUACYD_CONTROLLER_MAC
    string "CYD Wi-Fi MAC address"
    default "00:00:00:00:00:00"

config AQUACYD_ESPNOW_PMK
    string "ESP-NOW PMK as 32 hexadecimal characters"
    default ""

config AQUACYD_ESPNOW_LMK
    string "ESP-NOW LMK as 32 hexadecimal characters"
    default ""

config AQUACYD_CONTROLLER_OFFLINE_TIMEOUT_SECONDS
    int "Controller offline timeout in seconds"
    range 5 300
    default 15

endmenu
```

## firmware/esp32c6_gateway/sdkconfig.defaults
```kconfig
CONFIG_IDF_TARGET="esp32c6"
CONFIG_ESPTOOLPY_FLASHSIZE_4MB=y
CONFIG_PARTITION_TABLE_CUSTOM=y
CONFIG_PARTITION_TABLE_CUSTOM_FILENAME="partitions.csv"
CONFIG_ESP_WIFI_SOFTAP_SUPPORT=n
CONFIG_MQTT_PROTOCOL_5=n
CONFIG_COMPILER_OPTIMIZATION_PERF=y
CONFIG_FREERTOS_HZ=1000
CONFIG_LOG_DEFAULT_LEVEL_INFO=y
```

## firmware/esp32p4_hmi/main/Kconfig.projbuild
```kconfig
menu "AquaHub ESP32-P4"

config AQUAHUB_LOCAL_BROKER
    bool "Run the local MQTTS broker on ESP32-P4"
    default y

config AQUAHUB_MQTT_BROKER_PORT
    int "Local MQTTS broker port"
    range 1024 65535
    default 8883
    depends on AQUAHUB_LOCAL_BROKER

config AQUAHUB_API_PORT
    int "Local HTTPS API port"
    range 1024 65535
    default 8443

config AQUAHUB_CORS_ORIGIN
    string "Exact HTTPS origin allowed for the Flutter web client"
    default ""
    help
        Leave empty to disable cross-origin browser access. Never use '*'.
        Example: https://panel.example.lan

config AQUACYD_HMI_WIFI_SSID
    string "2.4 GHz Wi-Fi SSID"
    default ""

config AQUACYD_HMI_WIFI_PASSWORD
    string "Wi-Fi password"
    default ""

config AQUACYD_HMI_MQTT_BROKER_URI
    string "External MQTT broker URI (ignored with local broker)"
    default "mqtt://homeassistant.local:1883"

config AQUACYD_HMI_MQTT_USERNAME
    string "MQTT username (minimum 4 characters)"
    default ""

config AQUACYD_HMI_MQTT_PASSWORD
    string "MQTT password (minimum 12 characters)"
    default ""

config AQUACYD_HMI_MQTT_BASE_TOPIC
    string "AquaCYD MQTT base topic"
    default "aquacyd/aquarium"

config AQUACYD_HMI_ROTATE_180
    bool "Rotate display by 180 degrees"
    default y

endmenu
```

## firmware/esp32p4_hmi/sdkconfig.defaults
```kconfig
CONFIG_IDF_TARGET="esp32p4"
CONFIG_ESP32P4_SELECTS_REV_LESS_V3=y
CONFIG_ESP32P4_REV_MIN_1=y
CONFIG_ESPTOOLPY_FLASHMODE_QIO=y
CONFIG_ESPTOOLPY_FLASHSIZE_16MB=y
CONFIG_PARTITION_TABLE_CUSTOM=y
CONFIG_PARTITION_TABLE_CUSTOM_FILENAME="partitions.csv"
CONFIG_COMPILER_OPTIMIZATION_PERF=y
CONFIG_SPIRAM=y
CONFIG_SPIRAM_SPEED_200M=y
CONFIG_SPIRAM_XIP_FROM_PSRAM=y
CONFIG_CACHE_L2_CACHE_256KB=y
CONFIG_CACHE_L2_CACHE_LINE_128B=y
CONFIG_ESP_MAIN_TASK_STACK_SIZE=12288
CONFIG_FREERTOS_HZ=1000
CONFIG_LV_USE_CLIB_MALLOC=y
CONFIG_LV_USE_CLIB_STRING=y
CONFIG_LV_USE_CLIB_SPRINTF=y
CONFIG_LV_DEF_REFR_PERIOD=16
CONFIG_LV_OS_FREERTOS=y
CONFIG_LV_DRAW_SW_DRAW_UNIT_CNT=2
CONFIG_LV_ATTRIBUTE_FAST_MEM_USE_IRAM=y
CONFIG_LV_FONT_MONTSERRAT_16=y
CONFIG_LV_FONT_MONTSERRAT_20=y
CONFIG_LV_FONT_MONTSERRAT_24=y
CONFIG_LV_FONT_MONTSERRAT_28=y
CONFIG_LV_FONT_MONTSERRAT_36=y
CONFIG_LV_USE_FLEX=y
CONFIG_LV_USE_GRID=y
CONFIG_ESP_WIFI_SOFTAP_SUPPORT=n
CONFIG_HTTPD_WS_SUPPORT=y
CONFIG_MBEDTLS_PEM_WRITE_C=y
```

## firmware/esp32p4_hub/main/Kconfig.projbuild
```kconfig
menu "AquaHub ESP32-P4"

config AQUAHUB_LOCAL_BROKER
    bool "Run the local MQTTS broker on ESP32-P4"
    default y

config AQUAHUB_MQTT_BROKER_PORT
    int "Local MQTTS broker port"
    range 1024 65535
    default 8883
    depends on AQUAHUB_LOCAL_BROKER

config AQUAHUB_API_PORT
    int "Local HTTPS API port"
    range 1024 65535
    default 8443

config AQUAHUB_CORS_ORIGIN
    string "Exact HTTPS origin allowed for the Flutter web client"
    default ""
    help
        Leave empty to disable cross-origin browser access. Never use '*'.
        Example: https://panel.example.lan

config AQUAHUB_OTA_ENABLED
    bool "Enable the verified HTTPS OTA state machine"
    default y
    help
        Enables A/B firmware download, SHA-256 verification and rollback
        support. The feature remains unavailable at runtime until an HTTPS
        base URL is configured. Secure Boot v2 provides production image
        authenticity after per-device eFuse provisioning.

config AQUAHUB_OTA_BASE_URL
    string "HTTPS base URL containing manifest.json and firmware images"
    default ""
    depends on AQUAHUB_OTA_ENABLED
    help
        Example: https://releases.example.com/aquahub/stable
        Redirects and arbitrary URLs supplied by API clients are rejected.

config AQUAHUB_OTA_HTTP_TIMEOUT_MS
    int "OTA HTTPS operation timeout in milliseconds"
    range 5000 120000
    default 30000
    depends on AQUAHUB_OTA_ENABLED

config AQUAHUB_OTA_REBOOT_DELAY_MS
    int "Delay before reboot after a verified update"
    range 1000 30000
    default 5000
    depends on AQUAHUB_OTA_ENABLED

config AQUACYD_HMI_WIFI_SSID
    string "2.4 GHz Wi-Fi SSID"
    default ""

config AQUACYD_HMI_WIFI_PASSWORD
    string "Wi-Fi password"
    default ""

config AQUACYD_HMI_MQTT_BROKER_URI
    string "External MQTT broker URI (ignored with local broker)"
    default "mqtt://homeassistant.local:1883"

config AQUACYD_HMI_MQTT_USERNAME
    string "MQTT username (minimum 4 characters)"
    default ""

config AQUACYD_HMI_MQTT_PASSWORD
    string "MQTT password (minimum 12 characters)"
    default ""

config AQUACYD_HMI_MQTT_BASE_TOPIC
    string "AquaCYD MQTT base topic"
    default "aquacyd/aquarium"

config AQUACYD_HMI_ROTATE_180
    bool "Rotate display by 180 degrees"
    default y

endmenu
```
